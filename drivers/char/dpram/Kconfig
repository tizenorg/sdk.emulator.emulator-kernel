## drivers/char/dpram/Kconfig
```kconfig
config DPRAM
	tristate "DPRAM support"
	default y
	help
	  Please move to arch/arm/mach-pxa. It is mirage specific file

config MULTIPDP
	tristate "MULTIPDP support"
	default m
	help
	  So what?

config IPCMUX
	tristate "IPCMUX support"
	default m
	help
	  It is ipc mux driver for samsung ipc 3.0.
```

## drivers/gpu/fgles/Kconfig
```kconfig
#
# Exynos Video configuration
#

menuconfig TIZEN_FGLES
	bool "Tizen fake GLES passthrough driver support"
	depends on MACH_TIZEN && (DRM || FB)
	default n
	help
	  This module enables openGLES passthrough from emulated system
	  to hypervisor (for example, QEMU). Must be used together with fake
	  (hypervisor-aware) openGLES libraries.

if TIZEN_FGLES

config TIZEN_FGLES_FLOAT_ABI
	int "FGLES floating point procedure call interface"
	default 1
	help
	  Specify which floating point ABI calling standard to use:
	  1 - arm_softfpu
	  2 - arm_hardfpu
	  "1" is the right choice in majority of situations.
	  Note that the hard-float and soft-float ABIs are not link-compatible.
	  You must compile your entire program with the same ABI, and link with
	  a compatible set of libraries.

config TIZEN_FGLES_MINOR
	int "FGLES device node minor number"
	default 128
	help
	  Specify minor number for /dev/kfgles2 device node.
	  Major number for kfgles2 is always 10 (MISC devices).

config TIZEN_FGLES_DEBUG
	bool "FGLES calls debug messages"
	default no
	help
	  Enable FGLES debug messages.

endif # TIZEN_FGLES
```

## drivers/gpu/yagl/Kconfig
```kconfig
#
# YaGL configuration
#

config YAGL
	tristate "YaGL passthrough driver"
	depends on (DRM || FB)
	default n
	help
	  This module enables YaGL passthrough from emulated system
	  to hypervisor (for example, QEMU). Must be used together with fake
	  (hypervisor-aware) OpenGL ES libraries.

config YAGL_DEBUG
	bool "YaGL calls debug messages"
	depends on YAGL
	default n
	help
	  Enable YaGL debug messages.
```

## drivers/jack/Kconfig
```kconfig
#
# Character device configuration
#

menu "Character devices"

source "drivers/jack/Kconfig"

config JACK
	"jack"


endmenu
```

## drivers/maru/Kconfig
```kconfig
menuconfig MARU
	tristate "MARU virtual device drivers for emulator"
	default n

config MARU_VIRTIO_TOUCHSCREEN
	tristate "MARU Virtio Touchscreen Driver"
	depends on MARU != n

config MARU_CAMERA
	tristate "MARU Camera Driver"
	depends on MARU != n && VIDEO_DEV && VIDEO_V4L2
	select VIDEOBUF_VMALLOC

config MARU_BACKLIGHT
	tristate "MARU Backlight Driver"
	depends on MARU && BACKLIGHT_CLASS_DEVICE
	default y
	help
		Say Y to enable the backlight driver of MARU.

config MARU_JACK
	tristate "MARU Jack Driver"
	depends on MARU != n

config MARU_POWER_SUPPLY
	tristate "MARU Power supply Driver"
	depends on MARU != n && !POWER_SUPPLY

config MARU_VIRTIO_HWKEY
	tristate "MARU Virtio HW Key Driver"
	depends on MARU != n

config MARU_VIRTIO_TABLET
	tristate "MARU Virtio Tablet Driver"
	depends on MARU != n

config MARU_VIRTIO_KEYBOARD
	tristate "MARU Virtio Keyboard Driver"
	depends on MARU != n

config MARU_VIRTIO_EVDI
	tristate "MARU VirtIO Emulator Virtual Device Interface Driver"
	depends on MARU != n

config MARU_VIRTIO_SENSOR
	tristate "MARU VirtIO Virtual Sensor Device Driver"
	depends on MARU != n

config MARU_VIRTIO_NFC
	tristate "MARU VirtIO Virtual NFC Device Driver"
	depends on MARU != n

config MARU_BRILLCODEC
	tristate "MARU brillcodec driver"
	depends on MARU != n

config MARU_VIRTIO_VMODEM
	tristate "MARU VirtIO Virtual Modem Device Driver"
	depends on MARU != n

config MARU_VIRTIO_ROTARY
	tristate "MARU VirtIO Virtual Rotary Device Driver"
	depends on MARU != n

config MARU_EXTENSION_SOURCE
	tristate "MARU Extension source"
	depends on MARU != n

config MARU_EXTENSION_SOURCE_PATH
	string "MARU Extension source path"
	depends on MARU != n && MARU_EXTENSION_SOURCE != n
```

## drivers/power_supply/Kconfig
```kconfig
#
# Character device configuration
#

menu "Character devices"

source "drivers/power_supply/Kconfig"

config POWER_SUPPLY
	"power supply"


endmenu
```

## drivers/samsung/Kconfig
```kconfig
menu "Virtual device drivers for emulator"

config EMUL_LCD
	tristate "Samsung emulator LCD driver"
	default n

config EMUL_CODEC
	tristate "Samsung virtual codec driver for emulator"
	default n

endmenu
```

## drivers/usb_mass_storage/Kconfig
```kconfig
#
# Character device configuration
#

menu "Character devices"

source "drivers/usb_mass_storage/Kconfig"

config USB_MASS_STORAGE
	"usb mass storage"


endmenu
```

## drivers/usb_mode/Kconfig
```kconfig
#
# Character device configuration
#

menu "Character devices"

source "drivers/usb_mode/Kconfig"

config USB_MODE
	"usb_mode"


endmenu
```
